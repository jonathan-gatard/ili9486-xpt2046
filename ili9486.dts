/dts-v1/;
/plugin/;

/ {
    compatible = "allwinner,sun8i-h3";

        fragment@0 {
                target = <&spi1>;
                __overlay__ {
                        status = "okay";
                };
        };

        fragment@1 {
                target = <&spi1>;
                __overlay__ {
                        /* needed to avoid dtc warning */
                        #address-cells = <1>;
                        #size-cells = <0>;

                        ili9486: ili9486@0 {
                                compatible = "ilitek,ili9486";
                                reg = <0>;

                                spi-max-frequency = <16000000>;
                                rotate = <90>;
                                fps = <30>;
                                buswidth = <8>;
                                regwidth = <16>;
                                bgr = <0>;
                                reset-gpios = <&pio 0 2 1>; /* PA2 */
                                dc-gpios = <&pio 0 18 0>; /* PA18 */
                                //debug = <0>;

                                init = <0x10000b0 0x00
                                        0x1000011
                                        0x20000ff
                                        0x100003a 0x55
                                        0x1000036 0x28
                                        0x10000c2 0x44
                                        0x10000c5 0x00 0x00 0x00 0x00
                                        0x10000e0 0x0f 0x1f 0x1c 0x0c 0x0f 0x08 0x48 0x98 0x37 0x0a 0x13 0x04 0x11 0x0d 0x00
                                        0x10000e1 0x0f 0x32 0x2e 0x0b 0x0d 0x05 0x47 0x75 0x37 0x06 0x10 0x03 0x24 0x20 0x00
                                        0x10000e2 0x0f 0x32 0x2e 0x0b 0x0d 0x05 0x47 0x75 0x37 0x06 0x10 0x03 0x24 0x20 0x00
                                        0x1000036 0x28
                                        0x1000011
                                        0x1000029>;
                        };
                };
        };
};

